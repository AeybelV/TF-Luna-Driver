/dts-v1/;
/plugin/;

/ {
   compatible = "brcm,bcm2835", "brcm,bcm2836", "brcm,bcm2708", "brcm,bcm2709", "brcm,bcm2710", "bcrm,bcm2837";

    fragment@0 {
        target = <&uart1>;
        status = "okay";
        __overlay__ {
            tfluna-serdev {
                compatible = "benewake,tf-luna";
                status = "okay";
            };
        };
    };
};
